## Kconfig
```kconfig
# SPDX-License-Identifier: BSD-3-Clause
#

menu "MCUboot"
    config MCUX_COMPONENT_middleware.mcuboot.bootutil
        bool "Core MCUboot loader library"
        select MCUX_COMPONENT_middleware.mcuboot.nxp_bootutil_port
        default n
        help
            This option enables core bootutil library
            that is used by the bootloader code.

    config MCUX_COMPONENT_middleware.mcuboot.tinycrypt
        bool "Use TinyCrypt instead of MbedTLS"
        depends on !MCUX_COMPONENT_middleware.mbedtls3x
        select MCUX_COMPONENT_middleware.mcuboot.mbedtls-asn1 if MCUX_COMPONENT_middleware.mcuboot.bootutil
        help
            The TinyCrypt Library provides a minimalistic implementation of
            standard cryptography primitives.

    config MCUX_COMPONENT_middleware.mcuboot.mbedtls-asn1
        bool "Thin MbedTLS layer for ASN1 parsing"
        depends on MCUX_COMPONENT_middleware.mcuboot.tinycrypt
        help
            This is needed when TinyCrypt it used together with
            MCUboot bootutil library as TC does not support ASN1
            parsing.

    config MCUX_COMPONENT_middleware.mcuboot.nxp_encrypted_xip
        bool "Add support for encrypted XIP"
        default n
        depends on MCUX_COMPONENT_middleware.mcuboot.bootutil
        depends on MCUX_HW_DEVICE_MIMXRT1062 || MCUX_HW_DEVICE_MIMXRT1064 || \
                   MCUX_HW_DEVICE_MIMXRT1042 || MCUX_HW_DEVICE_MIMXRT1021 || \
                   MCUX_HW_DEVICE_MIMXRT1052 || MCUX_HW_DEVICE_RW612      || \
                   MCUX_HW_DEVICE_MCXN947    || MCUX_HW_DEVICE_MCXN547
        help
            Enables code that implements support for running from
            an encrypted mcuboot image. See documentation for details
            and device compatibility. Currently it cannot be combined with
            Flash Remapping support and PSA Crypto API. Requires TinyCrypt or 
            legacy Mbed TLS API.

    config MCUX_COMPONENT_middleware.mcuboot.nxp_app_support
        bool "Application layer to support access to MCUboot update mechanism"
        default n
        help
            This enables code that contains API to control MCUboot update
            mechanism from actively running application.

    config MCUX_COMPONENT_middleware.mcuboot.nxp_bootutil_port
        bool
        default n
        depends on MCUX_COMPONENT_middleware.mcuboot.bootutil
        help
            NXP port layer for MCUboot

    config MCUX_COMPONENT_middleware.mcuboot.stack_heap_default_mbedtls
        bool
        default y
        depends on MCUX_COMPONENT_middleware.mcuboot.bootutil
        depends on !MCUX_COMPONENT_middleware.mcuboot.tinycrypt
        help
            Default MCUboot stack/heap setup for configuration with MbedTLS

    config MCUX_COMPONENT_middleware.mcuboot.mbedtls_config
        bool
        default y
        depends on MCUX_COMPONENT_middleware.mcuboot.bootutil
        depends on !MCUX_COMPONENT_middleware.mcuboot.tinycrypt
        help
            Customized MbedTLS configuration headers

    config MCUX_COMPONENT_middleware.mcuboot.stack_heap_default_tinycrypt
        bool
        default y
        depends on MCUX_COMPONENT_middleware.mcuboot.bootutil
        depends on MCUX_COMPONENT_middleware.mcuboot.tinycrypt
        help
            Default MCUboot stack/heap setup for configuration with TinyCrypt

    config MCUX_COMPONENT_middleware.mcuboot.tinycrypt_config
        bool
        default y
        depends on MCUX_COMPONENT_middleware.mcuboot.bootutil
        depends on MCUX_COMPONENT_middleware.mcuboot.tinycrypt
        help
            Configuration headers needed for TinyCrypt backend



# Device Flash API automatically selected by device family

    config MCUX_COMPONENT_middleware.mcuboot.bootutil.flashapi_rt
        bool
        default y
        depends on MCUX_COMPONENT_middleware.mcuboot.bootutil
        depends on !MCUX_COMPONENT_middleware.mcuboot.bootutil.flashapi_mcx
        help
            Layer that connects mcuboot flash API with device specific flash API.
            This RT option is used on most devices.

    config MCUX_COMPONENT_middleware.mcuboot.bootutil.flashapi_mcx
        bool
        default y
        depends on MCUX_COMPONENT_middleware.mcuboot.bootutil
        depends on MCUX_HW_SOC_SERIES_MCX || is_device.KW47
        help
            Layer that connects mcuboot flash API with device specific flash API.
            Version for MCX devices.

# MCUboot configuration options

    config BOOT_CUSTOM_DEVICE_SETUP
        bool "Use custom device configuration"
        default n
        help
            This is used to setup custom device configuration using Kconfig and overwrite
            default settings in configuration headers

    if BOOT_CUSTOM_DEVICE_SETUP

        config BOOT_FLASH_ACT_APP_ADDRESS
            hex "Active application address"
            help
                Flash address of the active application - slot 0.

        config BOOT_FLASH_CAND_APP_ADDRESS
            hex "Candidate application address"
            help
                Flash address of the candidate application - slot 1.

        if ENCRYPT_XIP_EXT_ENABLE

            config BOOT_FLASH_ENC_META_ADDRESS
                hex "Encryption meta data address"
                help
                    Flash address of encryption meta data.
        endif

        config BOOT_FLASH_PADDING_SIZE
            hex "Trailing image padding"
            default 0x2000
            help
                Trailing image padding used to reserve space for image trailer
                structure that holds image status information. This option is not
                used on all platforms. See the code specifics in flash_partitioning.h/c

        config ENCRYPT_XIP_EXT_ENABLE
            bool "Enable Encrypted XIP mode"
            default n
            depends on MCUX_COMPONENT_middleware.mcuboot.nxp_encrypted_xip
            help
                Uses modified overwrite-only mode to utilize encrypted XIP

        choice
            prompt "Image handling strategy"
            default BOOT_FLASH_REMAP
            depends on !ENCRYPT_XIP_EXT_ENABLE

            config BOOT_OVERWRITE_ONLY
                bool "Update only strategy"
                help
                    This simple update only strategy overwrites image in the primary slot
                    with the new one in the secondary slot. It is not possible to revert back
                    to the previous version.
                    This mode can be extended with Encrypted XIP support

            config BOOT_SWAP_USING_MOVE
                bool "Image swapping by SW algorithm"
                help
                    This is a complex technique that swaps images and allows to revert back
                    to the previous version. It also produces more flash wear and requires
                    that the flash is able to work with incremental writes within erased flash page
                    It cannot be combined with Encrypted XIP support.

            config BOOT_FLASH_REMAP
                bool "Image swapping offloaded to HW"
                depends on MCUX_HW_DEVICE_MIMXRT1062 || MCUX_HW_DEVICE_MIMXRT1064 || \
                           MCUX_HW_DEVICE_MIMXRT1042 || \
                           MCUX_HW_DEVICE_MIMXRT1166 || MCUX_HW_DEVICE_MIMXRT1176 || \
                           MCUX_HW_DEVICE_MIMXRT595S || MCUX_HW_DEVICE_MIMXRT685S || \
                           MCUX_HW_DEVICE_MCXN947 || MCUX_HW_DEVICE_MCXN547 || \
                           MCUX_HW_DEVICE_RW612
                help
                    If hardware supports flash remapping it is possible
                    to use it together with MCUboot's DIRECT_XIP configuration
                    to enable zero-overhead image swapping.
                    Currently it cannot be combined with Encrypted XIP support.
        endchoice

        config BOOT_SIGNATURE
            bool "Check image signature before boot"
            default y
            help
                Always check the signature of the image in the primary slot before booting.

        choice
            prompt "Image signature algorithm"
            default BOOT_SIGNATURE_TYPE_ECDSA_P256

            config BOOT_SIGNATURE_TYPE_RSA
                bool "Use RSA for image signature validation"
                depends on !MCUX_COMPONENT_middleware.mcuboot.tinycrypt

            config BOOT_SIGNATURE_TYPE_ECDSA_P256
                bool "Use ECDSA P256 for image signature validation"
        endchoice

        choice
            prompt "Encrypted image algorithm of MCUboot to secure AES key"
            default BOOT_ENCRYPT_EC256
            depends on ENCRYPT_XIP_EXT_ENABLE
            
            config BOOT_ENCRYPT_RSA
                bool "Use RSA-OAEP to encrypt AES key"

            config BOOT_ENCRYPT_EC256
                bool "Use ECIES-P256 to encrypt AES key"        
        endchoice


        if BOOT_SIGNATURE_TYPE_RSA
            config BOOT_SIGNATURE_TYPE_RSA_LEN
                int
                default 2048
                help
                    MCUboot support RSA with either 2k or 3k bitlength setup. The default
                    SDK keys are of 2k length so only support this setup.
        endif


        config BOOT_BOOTSTRAP
            bool "Bootstrap primary image from secondary image"
            default y
            help
                This option installs primary image from an image provided in
                the secondary slot. This option is useful in situations when
                unsignned image in primary slot was downloaded by a debugger
                session and this running unsigned binary was used to download an
                already signed image to the secondary slot. After reboot MCUboot
                detects this situation as bootstraps a signed image for the primary
                slot from the one in the secondary slot.

        config MCUBOOT_MAX_IMG_SECTORS
            int "Maximum number of sectors in image"
            default 800

        config BOOT_USE_PSA_CRYPTO
            bool
            default y
            depends on MCUX_COMPONENT_middleware.mbedtls3x
            depends on !MCUX_COMPONENT_middleware.mcuboot.tinycrypt
            depends on !MCUX_COMPONENT_middleware.mcuboot.nxp_encrypted_xip

        config BOOT_USE_MBEDTLS
            bool
            default y
            depends on MCUX_COMPONENT_middleware.mbedtls3x
            depends on !MCUX_COMPONENT_middleware.mcuboot.tinycrypt
            depends on MCUX_COMPONENT_middleware.mcuboot.nxp_encrypted_xip

        config BOOT_USE_TINYCRYPT
            bool
            default y
            depends on MCUX_COMPONENT_middleware.mcuboot.tinycrypt

        config MCUBOOT_FLASH_REMAP_ENABLE
            bool
            default y
            depends on BOOT_FLASH_REMAP


    endif

# Board/device specific configurations - MCXN9
    config MCUX_COMPONENT_middleware.mcuboot.mcxn_custom_cfg.main_flash_only
        bool "(MCXN only) MCUboot is located in main flash"
        default n
        depends on MCUX_HW_DEVICE_MCXN947 || MCUX_HW_DEVICE_MCXN547
        depends on !BOOT_FLASH_REMAP
        help
            (MCXN9 only) By default the MCUboot is located in IFR region to utilize
            flash remapping feature, however, this flash partition layout
            limits usage of some features (mbedTLS, encrypted XIP etc).
            Enable this to move the bootloader from IFR region to main flash.
            This configuration uses custom linker file and  doesn't support 
            image swapping offloaded to HW.

    config MCXN_CUSTOM_CFG_MAIN_FLASH_ONLY
        bool
        default y
        depends on MCUX_COMPONENT_middleware.mcuboot.mcxn_custom_cfg.main_flash_only

endmenu
```
